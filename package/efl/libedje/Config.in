## package/efl/libedje/Config.in
```kconfig
config BR2_PACKAGE_LIBEDJE
	bool "libedje"
	select BR2_PACKAGE_LIBEINA
	select BR2_PACKAGE_LIBEET
	select BR2_PACKAGE_LIBECORE
	select BR2_PACKAGE_LIBECORE_EVAS
	select BR2_PACKAGE_LIBEMBRYO
	select BR2_PACKAGE_LIBEVAS
	select BR2_PACKAGE_LUA
	help
	  A graphical layout and animation library for animated
	  resizable, compressed and scalable themes.

	  http://trac.enlightenment.org/e/wiki/Edje

config BR2_PACKAGE_LIBEDJE_TOOLS
	bool "build Edje tools"
	depends on BR2_PACKAGE_LIBEDJE
	help
	  Build and install the Edje tools for the target:
	  edje-cc, edje-decc, edje-recc, edje-player,
	  edje-inspector
	  Normally this is not required.
```

## package/python-cython/Config.in
```kconfig
config BR2_PACKAGE_PYTHON_CYTHON
	bool "cython"
	depends on BR2_PACKAGE_PYTHON
	help
	  C extensions for Python

	  Cython is a language that makes writing C extensions for the Python
	  language as easy as Python itself. It is based on the well-known
	  Pyrex, but supports more cutting edge functionality and optimizations.

	  http://cython.org
```

## package/python-efl/Config.in
```kconfig
menuconfig BR2_PACKAGE_EFLPYTHON
	bool "Python bindings for the EFL"
	depends on BR2_PACKAGE_PYTHON
	select BR2_PACKAGE_EFL
	help
	  Allow to use the EFL with Python.

if BR2_PACKAGE_EFLPYTHON
	source "package/python-efl/python-evas/Config.in"
endif
```

## package/python-efl/python-ecore/Config.in
```kconfig
config BR2_PACKAGE_PYTHON_ECORE
	bool "python-ecore"
	depends on BR2_PACKAGE_PYTHON
	select BR2_PACKAGE_LIBECORE
	select BR2_PACKAGE_PYTHON_CYTHON
	help
	  Enable the Python bindings for Ecore.
```

## package/python-efl/python-edje/Config.in
```kconfig
config BR2_PACKAGE_PYTHON_EDJE
	bool "python-edje"
	depends on BR2_PACKAGE_PYTHON
	select BR2_PACKAGE_LIBEDJE
	select BR2_PACKAGE_PYTHON_CYTHON
	help
	  Enable the Python bindings for Edje.
```

## package/python-efl/python-elementary/Config.in
```kconfig
config BR2_PACKAGE_PYTHON_ELEMENTARY
	bool "python-elementary"
	depends on BR2_PACKAGE_PYTHON
	select BR2_PACKAGE_LIBELEMENTARY
	select BR2_PACKAGE_PYTHON_CYTHON
	help
	  Enable the Python bindings for Elementary.
```

## package/python-efl/python-evas/Config.in
```kconfig
config BR2_PACKAGE_PYTHON_EVAS
	bool "python-evas"
	depends on BR2_PACKAGE_PYTHON
	select BR2_PACKAGE_LIBEVAS
	select BR2_PACKAGE_PYTHON_CYTHON
	help
	  Enable the Python bindings for Evas.
```
